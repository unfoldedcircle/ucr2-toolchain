## buildroot-external/configs/ucr2_toolchain_defconfig
```kconfig
BR2_aarch64=y
BR2_cortex_a55=y
BR2_ARM_FPU_VFPV4=y
BR2_DL_DIR="$(HOME)/buildroot/dl"
BR2_GNU_MIRROR="http://ftp.thunix.net/gnu-ftp"
BR2_CCACHE=y
BR2_CCACHE_DIR="$(HOME)/buildroot/ccache"
BR2_OPTIMIZE_2=y
BR2_PACKAGE_OVERRIDE_FILE="$(BR2_EXTERNAL_UNFOLDEDOS_PATH)/local.mk"
BR2_GLOBAL_PATCH_DIR="$(BR2_EXTERNAL_UNFOLDEDOS_PATH)/patches"
BR2_TOOLCHAIN_EXTERNAL=y
BR2_INIT_SYSTEMD=y
BR2_SYSTEM_BIN_SH_NONE=y
BR2_TARGET_GENERIC_GETTY_PORT="ttyS2"
# BR2_TARGET_GENERIC_REMOUNT_ROOTFS_RW is not set
BR2_GENERATE_LOCALE="en_US.UTF-8"
BR2_ROOTFS_POST_BUILD_SCRIPT="$(BR2_EXTERNAL_UNFOLDEDOS_PATH)/scripts/post-build.sh"
# BR2_PACKAGE_BUSYBOX is not set
BR2_PACKAGE_FBSET=y
BR2_PACKAGE_FBV=y
BR2_PACKAGE_MESA3D=y
BR2_PACKAGE_MESA3D_GALLIUM_DRIVER_PANFROST=y
BR2_PACKAGE_MESA3D_OPENGL_EGL=y
BR2_PACKAGE_MESA3D_OPENGL_ES=y
BR2_PACKAGE_SDL2=y
BR2_PACKAGE_LIBUBOOTENV=y
BR2_PACKAGE_ALSA_LIB=y
BR2_PACKAGE_LZ4=y
BR2_PACKAGE_LZO=y
BR2_PACKAGE_CA_CERTIFICATES=y
BR2_PACKAGE_GNUTLS=y
BR2_PACKAGE_LIBNSS=y
BR2_PACKAGE_LIBCONFIG=y
BR2_PACKAGE_WOFF2=y
BR2_PACKAGE_LIBGPIOD=y
BR2_PACKAGE_JSON_C=y
BR2_PACKAGE_LIBCURL=y
BR2_PACKAGE_LIBCURL_CURL=y
BR2_PACKAGE_LIBCURL_GNUTLS=y
BR2_PACKAGE_LIBEVDEV=y
BR2_PACKAGE_LIBEVENT=y
BR2_PACKAGE_POPT=y
BR2_PACKAGE_GOOGLEFONTDIRECTORY=y
BR2_PACKAGE_GOOGLEFONTDIRECTORY_FONTS="ofl/poppins ofl/spacemono"
BR2_PACKAGE_AVAHI=y
# BR2_PACKAGE_AVAHI_AUTOIPD is not set
BR2_PACKAGE_AVAHI_DAEMON=y
BR2_PACKAGE_BLUEZ_TOOLS=y
BR2_PACKAGE_BLUEZ5_UTILS=y
# BR2_PACKAGE_BLUEZ5_UTILS_PLUGINS_NETWORK is not set
BR2_PACKAGE_IPTABLES=y
BR2_PACKAGE_IW=y
BR2_PACKAGE_WIRELESS_REGDB=y
BR2_PACKAGE_WPA_SUPPLICANT=y
BR2_PACKAGE_WPA_SUPPLICANT_AP_SUPPORT=y
BR2_PACKAGE_WPA_SUPPLICANT_AUTOSCAN=y
BR2_PACKAGE_WPA_SUPPLICANT_HOTSPOT=y
BR2_PACKAGE_WPA_SUPPLICANT_WPS=y
BR2_PACKAGE_WPA_SUPPLICANT_WPA3=y
BR2_PACKAGE_WPA_SUPPLICANT_WPA_CLIENT_SO=y
BR2_PACKAGE_WPA_SUPPLICANT_CTRL_IFACE=y
# BR2_PACKAGE_SWUPDATE_WEBSERVER is not set
BR2_TARGET_ROOTFS_EXT2=y
BR2_TARGET_ROOTFS_EXT2_4=y
BR2_TARGET_ROOTFS_EXT2_SIZE="400M"
# BR2_TARGET_ROOTFS_TAR is not set
BR2_PACKAGE_HOST_DOS2UNIX=y
BR2_PACKAGE_HOST_DOSFSTOOLS=y
BR2_PACKAGE_HOST_GENIMAGE=y
BR2_PACKAGE_HOST_MTOOLS=y
BR2_PACKAGE_HOST_ZIP=y
BR2_PACKAGE_UC_BASE=y
```

## buildroot-external/package/uc-base/Config.in
```kconfig
comment "Qt5 static needs host g++ >= 5.0, and a toolchain w/ gcc >= 5.0, wchar, NPTL, C++, dynamic library"
	depends on !BR2_ARM_CPU_ARMV4
	depends on !BR2_arc
	depends on !BR2_INSTALL_LIBSTDCPP || !BR2_USE_WCHAR || \
		!BR2_TOOLCHAIN_HAS_THREADS_NPTL || BR2_STATIC_LIBS || \
		!BR2_HOST_GCC_AT_LEAST_5 || !BR2_TOOLCHAIN_GCC_AT_LEAST_5

config BR2_PACKAGE_UC_BASE
	bool "Unfolded Circle Remote Two base environment"
	# packages required by the Qt remote-ui app / using the SDK to build the static Qt cross compile toolchain
	depends on BR2_INSTALL_LIBSTDCPP
	depends on BR2_USE_WCHAR
	depends on BR2_TOOLCHAIN_HAS_THREADS_NPTL
	depends on BR2_HOST_GCC_AT_LEAST_5 # Full C++11
	depends on BR2_TOOLCHAIN_GCC_AT_LEAST_5 # C++11, GCC_BUG_57694
	depends on !BR2_ARM_CPU_ARMV4 # needs ARMv5+
	# no built-in double-conversion support
	depends on !BR2_arc
	depends on !BR2_STATIC_LIBS
	select BR2_PACKAGE_ZLIB
	select BR2_PACKAGE_PCRE2
	select BR2_PACKAGE_PCRE2_16
	select BR2_PACKAGE_LIBOPENSSL_ENABLE_PSK if BR2_PACKAGE_LIBOPENSSL
	select BR2_PACKAGE_FREETYPE
	select BR2_PACKAGE_FONTCONFIG
	select BR2_PACKAGE_JPEG
	select BR2_PACKAGE_LIBPNG
	select BR2_PACKAGE_LIBSVG
	# required by the remote-core service: links to library
	select BR2_PACKAGE_SWUPDATE
	select BR2_PACKAGE_DBUS
	help
	  Install the base runtime environment for the Unfolded Circle
	  Remote Two software.
```
